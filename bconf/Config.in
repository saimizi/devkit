## bconf/Config.in
```kconfig
config BR2_BCONF
	bool "Bconf packages support."

choice BR2_BF_BOARD
	depends on BR2_BCONF
	prompt "Target Board"

config BR2_BF_PANDABOARD_ES
	bool "Pandaboard ES"
endchoice

config BR2_BF_GIT_SERVER
	string "Bconf package git repository"
	depends on BR2_BCONF
	default ""

config BR2_BF_GIT_SERVER_LOCAL
	string "Bconf package local git repository"
	depends on BR2_BCONF && !BR2_BF_PANDABOARD_ES
	default ""

config BR2_BF_TFTP_DIR
	string "TFTP directory"
	depends on BR2_BCONF && BR2_BF_PANDABOARD_ES
	default "/tftpboot"

choice
	prompt "Boot method"
	depends on BR2_BF_PANDABOARD_ES

config BR2_BF_BOOT_METHOD_NFSBOOT
	bool "NFS boot"

config BR2_BF_BOOT_METHOD_FLASH
	bool "Flash boot"

endchoice

config BR2_BF_NFSROOT_PATH
	string "NFSRoot path"
	depends on BR2_BCONF
	default "$(BASE_DIR)/nfsroot"

config BR2_BF_TARGET_IP
	string 
	depends on BR2_BF_NFSBOOT
	option env="TARGET_IP"

config BR2_BF_SERVER_IP
	string 
	depends on BR2_BF_NFSBOOT
	option env="SERVER_IP"

config BR2_BF_NETMSK
	string 
	depends on BR2_BF_NFSBOOT
	option env="NETMASK"

config BR2_BF_GATEWAY
	string 
	depends on BR2_BF_NFSBOOT
	option env="GATEWAY_IP"

config BR2_BF_MEMORY
	string "System memory"
	depends on BR2_BCONF
	default "1024M"

config BR2_BF_BOOTARGS_APPEND
	string "Other Linux boot args"
	depends on BR2_BCONF
	default ""

comment "Packages needs Bconf package git repository"
	depends on BR2_BF_GIT_SERVER = ""


source "$BR2_EXTERNAL_BCONF_PATH/package/Config.in"
```

## bconf/configs/pandaboard_es_defconfig
```kconfig
BR2_arm=y
BR2_cortex_a9=y
BR2_ARM_ENABLE_NEON=y
BR2_ARM_ENABLE_VFP=y
BR2_ARM_FPU_NEON=y
BR2_ARM_INSTRUCTIONS_THUMB2=y
BR2_DL_DIR="$(HOME)/dl"
BR2_CCACHE=y
BR2_TOOLCHAIN_EXTERNAL=y
BR2_TOOLCHAIN_EXTERNAL_CUSTOM=y
BR2_TOOLCHAIN_EXTERNAL_PATH="/usr/local/arm-newtry-linux-gnueabihf"
BR2_TOOLCHAIN_EXTERNAL_CUSTOM_PREFIX="arm-newtry-linux-gnueabihf"
BR2_TOOLCHAIN_EXTERNAL_GCC_4_9=y
BR2_TOOLCHAIN_EXTERNAL_HEADERS_3_18=y
BR2_TOOLCHAIN_EXTERNAL_CUSTOM_GLIBC=y
BR2_TOOLCHAIN_EXTERNAL_CXX=y
BR2_TOOLCHAIN_EXTERNAL_GDB_SERVER_COPY=y
BR2_TARGET_GENERIC_HOSTNAME="WaterbridgeD"
BR2_TARGET_GENERIC_ISSUE="Welcome to Newtry"
BR2_ROOTFS_DEVICE_CREATION_DYNAMIC_EUDEV=y
BR2_TARGET_GENERIC_GETTY_PORT="/dev/ttyO2"
BR2_TARGET_GENERIC_GETTY_BAUDRATE_115200=y
BR2_ENABLE_LOCALE_WHITELIST="C"
BR2_ROOTFS_OVERLAY="$(BR2_EXTERNAL_BCONF_PATH)/board/pandaboard_es/rootfs_overlay"
BR2_ROOTFS_POST_BUILD_SCRIPT="$(BR2_EXTERNAL_BCONF_PATH)/board/pandaboard_es/pre_image.sh"
BR2_ROOTFS_POST_IMAGE_SCRIPT="$(BR2_EXTERNAL_BCONF_PATH)/board/pandaboard_es/post_image.sh"
BR2_ROOTFS_POST_SCRIPT_ARGS="$(BR2_BF_NFSROOT_PATH)"
BR2_LINUX_KERNEL=y
BR2_LINUX_KERNEL_CUSTOM_VERSION=y
BR2_LINUX_KERNEL_CUSTOM_VERSION_VALUE="4.7.2"
BR2_LINUX_KERNEL_USE_CUSTOM_CONFIG=y
BR2_LINUX_KERNEL_CUSTOM_CONFIG_FILE="$(BR2_EXTERNAL_BCONF_PATH)/board/pandaboard_es/linux-4.7.2.config"
BR2_LINUX_KERNEL_APPENDED_UIMAGE=y
BR2_LINUX_KERNEL_UIMAGE_LOADADDR="0x80008000"
BR2_LINUX_KERNEL_INTREE_DTS_NAME="omap4-panda-es"
BR2_LINUX_KERNEL_INSTALL_TARGET=y
BR2_PACKAGE_LINUX_TOOLS_CPUPOWER=y
BR2_PACKAGE_LINUX_TOOLS_PERF=y
BR2_PACKAGE_LINUX_FIRMWARE=y
BR2_PACKAGE_LINUX_FIRMWARE_ATHEROS_6002=y
BR2_PACKAGE_LINUX_FIRMWARE_ATHEROS_6003=y
BR2_PACKAGE_LINUX_FIRMWARE_ATHEROS_6004=y
BR2_PACKAGE_LINUX_FIRMWARE_ATHEROS_7010=y
BR2_PACKAGE_LINUX_FIRMWARE_ATHEROS_9170=y
BR2_PACKAGE_LINUX_FIRMWARE_ATHEROS_9271=y
BR2_PACKAGE_LINUX_FIRMWARE_BRCM_BCM43XX=y
BR2_PACKAGE_LINUX_FIRMWARE_BRCM_BCM43XXX=y
BR2_PACKAGE_LINUX_FIRMWARE_MEDIATEK_MT7601U=y
BR2_PACKAGE_LINUX_FIRMWARE_TI_WL127X=y
BR2_PACKAGE_SQLITE=y
BR2_PACKAGE_SQLITE_STAT3=y
BR2_PACKAGE_SQLITE_ENABLE_FTS3=y
BR2_PACKAGE_SQLITE_ENABLE_UNLOCK_NOTIFY=y
BR2_PACKAGE_SQLITE_SECURE_DELETE=y
BR2_PACKAGE_LIBXML2=y
BR2_PACKAGE_LIBNL_TOOLS=y
BR2_PACKAGE_CRDA=y
BR2_PACKAGE_IW=y
BR2_PACKAGE_WPA_SUPPLICANT=y
BR2_PACKAGE_WPA_SUPPLICANT_AP_SUPPORT=y
BR2_PACKAGE_WPA_SUPPLICANT_WIFI_DISPLAY=y
BR2_PACKAGE_WPA_SUPPLICANT_AUTOSCAN=y
BR2_PACKAGE_WPA_SUPPLICANT_EAP=y
BR2_PACKAGE_WPA_SUPPLICANT_HOTSPOT=y
BR2_PACKAGE_WPA_SUPPLICANT_DEBUG_SYSLOG=y
BR2_PACKAGE_WPA_SUPPLICANT_WPS=y
BR2_PACKAGE_WPA_SUPPLICANT_CLI=y
BR2_PACKAGE_WPA_SUPPLICANT_WPA_CLIENT_SO=y
BR2_PACKAGE_WPA_SUPPLICANT_PASSPHRASE=y
BR2_TARGET_ROOTFS_EXT2=y
BR2_TARGET_ROOTFS_EXT2_4=y
BR2_TARGET_ROOTFS_EXT2_BLOCKS=81920
BR2_TARGET_UBOOT=y
BR2_TARGET_UBOOT_BUILD_SYSTEM_KCONFIG=y
BR2_TARGET_UBOOT_BOARD_DEFCONFIG="omap4_panda"
BR2_TARGET_UBOOT_FORMAT_IMG=y
BR2_TARGET_UBOOT_SPL=y
BR2_TARGET_UBOOT_SPL_NAME="MLO"
BR2_PACKAGE_HOST_GENIMAGE=y
BR2_PACKAGE_HOST_OMAP_U_BOOT_UTILS=y
BR2_PACKAGE_HOST_QEMU=y
BR2_PACKAGE_HOST_UBOOT_TOOLS_FIT_SUPPORT=y
BR2_BCONF=y
BR2_BF_GIT_SERVER="file:///home/joukan/gitrep"
BR2_BF_BOOTARGS_APPEND="initcall_debug print_time=1"
BR2_PACKAGE_LIBTRACE=y
BR2_PACKAGE_IPCON=y
```

## bconf/configs/qemu_x86_64_defconfig
```kconfig
BR2_x86_64=y
BR2_x86_corei7=y
BR2_DL_DIR="$(HOME)/dl"
BR2_CCACHE=y
BR2_TOOLCHAIN_BUILDROOT_GLIBC=y
BR2_KERNEL_HEADERS_4_4=y
BR2_BINUTILS_VERSION_2_30_X=y
BR2_TOOLCHAIN_BUILDROOT_CXX=y
BR2_GCC_ENABLE_LTO=y
BR2_PACKAGE_HOST_GDB=y
BR2_ROOTFS_POST_IMAGE_SCRIPT="$(BR2_EXTERNAL_BCONF_PATH)/board/qemu_x/post_image.sh"
BR2_ROOTFS_POST_SCRIPT_ARGS="$(BR2_BF_NFSROOT_PATH)"
BR2_LINUX_KERNEL=y
BR2_LINUX_KERNEL_CUSTOM_VERSION=y
BR2_LINUX_KERNEL_CUSTOM_VERSION_VALUE="4.16.7"
BR2_LINUX_KERNEL_USE_CUSTOM_CONFIG=y
BR2_LINUX_KERNEL_CUSTOM_CONFIG_FILE="$(BR2_EXTERNAL_BCONF_PATH)/board/qemu_x/x86_64/linux.config"
BR2_PACKAGE_BUSYBOX_CONFIG="$(BR2_EXTERNAL_BCONF_PATH)/board/qemu_x/busybox.config"
BR2_PACKAGE_LIBNL=y
BR2_PACKAGE_LIBNL_TOOLS=y
BR2_TARGET_ROOTFS_EXT2=y
BR2_TARGET_ROOTFS_EXT2_4=y
# BR2_TARGET_ROOTFS_TAR is not set
BR2_BCONF=y
BR2_BF_QEMU_X86_64=y
```

## bconf/package/Config.in
```kconfig
menu "Packages"

menu "Base package"
endmenu

menu "Drivers"
endmenu

menu "Libraies"
source "$BR2_EXTERNAL_BCONF_PATH/package/libtrace/Config.in"
endmenu

menu "Applications"
source "$BR2_EXTERNAL_BCONF_PATH/package/netmgr/Config.in"
endmenu

endmenu
```

## bconf/package/bf_ltrace/Config.in
```kconfig
config BR2_PACKAGE_BF_LTRACE
	bool "ltrace (Experiment)"
	depends on BR2_aarch64
	select BR2_PACKAGE_ELFUTILS
	depends on BR2_USE_WCHAR # elfutils
	depends on !BR2_STATIC_LIBS # elfutils
	depends on BR2_TOOLCHAIN_USES_UCLIBC || BR2_TOOLCHAIN_USES_GLIBC # elfutils
	help
	  Debugging program which runs a specified command until it exits.
	  While the command is executing, ltrace intercepts and records
	  the dynamic library calls which are called by the executed
	  process and the signals received by that process.

	  Note:
	    The Latest stable version is 0.7.3 which does NOT support aarch64.
	    This bf package is a git clone one (0.7.91) maybe buggy.
	    

	  http://ltrace.org
```

## bconf/package/ipcon/Config.in
```kconfig
comment "ipcon package needs libnl package"
	depends on !BR2_PACKAGE_LIBNL

config BR2_PACKAGE_IPCON
	bool "ipcon"
	depends on BR2_BCONF && BR2_PACKAGE_LIBNL
```

## bconf/package/libipcon/Config.in
```kconfig
comment "ipcon package needs libnl package"
	depends on !BR2_PACKAGE_LIBNL

comment "ipcon package needs ipcon driver"
	depends on !BR2_LINUX_KERNEL_EXT_IPCON_DRIVER

config BR2_PACKAGE_LIBIPCON
	bool "libipcon"
	depends on BR2_BCONF && BR2_PACKAGE_LIBNL && BR2_LINUX_KERNEL_EXT_IPCON_DRIVER
```

## bconf/package/udaemon/Config.in
```kconfig
config BR2_PACKAGE_UDAEMON
	bool "udaemon"
	depends on BR2_BCONF && (BR2_BF_PANDABOARD_ES)
```
